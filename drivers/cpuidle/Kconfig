## drivers/cpuidle/Kconfig
```kconfig
menu "CPU idle PM support"

config CPU_IDLE
	bool "CPU idle PM support"
	help
	  CPU idle is a generic framework for supporting software-controlled
	  idle processor power management.  It includes modular cross-platform
	  governors that can be swapped during runtime.

	  If you're using a mobile platform that supports CPU idle PM (e.g.
	  an ACPI-capable notebook), you should say Y here.

if CPU_IDLE

comment "Governors"

config CPU_IDLE_GOV_LADDER
	tristate "'ladder' governor"
	depends on CPU_IDLE
	default y
	help
	  This cpuidle governor promotes and demotes through the supported idle
	  states using residency time and bus master activity as metrics.  This
	  algorithm was originally introduced in the old ACPI processor driver.

endif	# CPU_IDLE

endmenu
```

## lib/tracing/Kconfig
```kconfig
# Archs that enable MCOUNT should select HAVE_MCOUNT
config HAVE_MCOUNT
       bool

# MCOUNT itself is useless, or will just be added overhead.
# It needs something to register a function with it.
config MCOUNT
	bool
	select FRAME_POINTER
```
